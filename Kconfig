## Kconfig
```kconfig
config USR_DRV_SPI
  bool  "userspace SPI driver"
  default y
  ---help---
  Support for STM32F4 SPI hardware IP.

if USR_DRV_SPI

menu "SPI block configuration"

config SPI1
  bool "SPI1 activation"
  default y
  ---help---
  Enable SPI1 block.
  
if SPI1

config SPI1_ROLE_MASTER
  bool "SPI1 role Master"
  default y
  ---help---
  Defines the SPI1 role Master or Slave
  
endif

config SPI2
  bool "SPI2 activation"
  default n
  ---help---
  Enable SPI2 block.

if SPI2

config SPI2_ROLE_MASTER
  bool "SPI2 role Master"
  default y
  ---help---
  Defines the SPI2 role Master or Slave
  
endif

config SPI3
  bool "SPI3 activation"
  default n
  ---help---
  Enable SPI3 block.

if SPI3

config SPI3_ROLE_MASTER
  bool "SPI3 role Master"
  default y
  ---help---
  Defines the SPI3 role Master or Slave
  
endif

config SPI4
  bool "SPI4 activation"
  default n
  ---help---
  Enable SPI4 block.

if SPI4

config SPI4_ROLE_MASTER
  bool "SPI4 role Master"
  default y
  ---help---
  Defines the SPI4 role Master or Slave
  
endif
endmenu

endif
```
